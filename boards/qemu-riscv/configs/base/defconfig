## boards/qemu-riscv64/Kconfig
```kconfig
# SPDX-License-Identifier: CECILL-C
# Copyright (c) 2026 Philippe Leduc

if BOARD_QEMU_RISCV64

config KICKOS_USER_HEAP_SIZE
	int
	default 65536

endif
```

## boards/qemu-x86_64/configs/base/defconfig
```kconfig
# SPDX-License-Identifier: CECILL-C
# Copyright (c) 2026 Philippe Leduc

CONFIG_BOARD_QEMU_X86_64=y

CONFIG_KICKOS_ENABLE_SELFTEST=y
```

## boards/qemu-x86_64/configs/smp2/defconfig
```kconfig
# SPDX-License-Identifier: CECILL-C
# Copyright (c) 2026 Philippe Leduc

CONFIG_BOARD_QEMU_X86_64=y
CONFIG_KICKOS_CORES_TWO=y
CONFIG_KICKOS_MULTICORE_SHARED=y
CONFIG_KICKOS_MAX_SPAWN_GRANTS=9
CONFIG_KICKOS_BENCH=y
CONFIG_KICKOS_BUDGET_ENDPOINTS=12
```

## boards/qemu-x86_64/configs/smp8/defconfig
```kconfig
# SPDX-License-Identifier: CECILL-C
# Copyright (c) 2026 Philippe Leduc

CONFIG_BOARD_QEMU_X86_64=y
CONFIG_KICKOS_CORES_EIGHT=y
CONFIG_KICKOS_MULTICORE_SHARED=y
CONFIG_KICKOS_ENABLE_SELFTEST=y
CONFIG_KICKOS_BENCH=y
CONFIG_KICKOS_MAX_THREADS=32
CONFIG_KICKOS_MAX_ENDPOINTS=16
CONFIG_KICKOS_TASK_ENDPOINT_BUDGET=12
CONFIG_KICKOS_CAP_TABLE_SUPPLY=32
```
