## boards/picopi/configs/st/defconfig
```kconfig
# SPDX-License-Identifier: CECILL-C
# Copyright (c) 2026 Philippe Leduc

CONFIG_BOARD_PICOPI=y

CONFIG_MEMORY_MODEL_MPU=y
CONFIG_KICKOS_USER_STACK_SIZE=8192
CONFIG_KICKOS_IDLE_STACK_SIZE=512
CONFIG_KICKOS_ROOT_STACK_SIZE=8192
CONFIG_KICKOS_ENABLE_SELFTEST=y
CONFIG_KICKOS_MAX_SPAWN_GRANTS=9
CONFIG_KICKOS_REBOOT=y
```

## boards/qemu-arm64/configs/benchsmp12/defconfig
```kconfig
# SPDX-License-Identifier: CECILL-C
# Copyright (c) 2026 Philippe Leduc

CONFIG_BOARD_QEMU_ARM64=y
CONFIG_KICKOS_CORES_TWELVE=y
CONFIG_ARM64_GIC_V3=y

CONFIG_KICKOS_MAX_THREADS=48
CONFIG_KICKOS_ASPACE_RANGES=64
CONFIG_KICKOS_MAX_ENDPOINTS=16
CONFIG_KICKOS_TASK_ENDPOINT_BUDGET=12
CONFIG_KICKOS_CAP_TABLE_SUPPLY=32
CONFIG_KICKOS_USER_STACK_SIZE=12288
CONFIG_KICKOS_IDLE_STACK_SIZE=4096
CONFIG_KICKOS_ROOT_STACK_SIZE=20480

CONFIG_KICKOS_ENABLE_SELFTEST=y
CONFIG_KICKOS_BENCH=y
```
