## Kconfig
```kconfig
# SPDX-License-Identifier: CECILL-C
# Copyright (c) 2026 Philippe Leduc
#
# KickOS configuration. Symbols are declared without a prefix, as in every Kconfig
# dialect; the tooling adds CONFIG_ when it writes .config and the generated header.

mainmenu "KickOS configuration"

# --- Capability facts -------------------------------------------------------
# Never prompted: a chip or an arch selects them. A fact is declared here only when
# some option's availability or default depends on it.

config HAS_MPU
	bool
	help
	  The chip carves the KICKOS_HAVE_MPU .appdata window AND its arch ships a
	  real arch_mpu_apply, so enforcement faults instead of granting no regions.

config HAS_TRACE_CLOCK
	bool
	default y if ARCH_SIM || ARCH_ARMV7M || ARCH_RXV3 || ARCH_LX6
	help
	  An arch_trace_now exists AND the core it runs on implements the counter it
	  reads. A chip that has a usable counter selects it back on. rv32imac is
	  per-chip: the arch reader is rdcycle, which traps on the ESP32-C6 HP core.

config HAS_ASPACE
	bool
	help
	  The chip translates rather than describing regions: its arch ships the
	  arch_aspace_* family and its linker script carves the frame pool those
	  tables come from. The two families are exclusive, so a chip selecting this
	  must not select HAS_MPU.

config KICKOS_HAVE_ASPACE
	int
	default 1 if HAS_ASPACE
	default 0
	help
	  HAS_ASPACE as a number the generated fragment can carry. The capability is
	  stated twice: here, and by arch/<family>/chip/<chip>/aspace.cmake. This is
	  the half CMake cannot compute, so it is what the agreement check in
	  CMakeLists.txt compares against.

config KICKOS_TRACE_CLOCK_DECLARED
	int
	default 1 if HAS_TRACE_CLOCK
	default 0
	help
	  HAS_TRACE_CLOCK as a number the generated fragment can carry. The capability
	  is stated twice: here, and by arch/<family>/chip/<chip>/caps.cmake plus the
	  arch ladder in CMakeLists.txt. This is the half CMake cannot compute, so it is
	  what the agreement check there compares against.

source "boards/Kconfig"
source "boards/*/Kconfig"
source "arch/Kconfig"

# --- Cores ------------------------------------------------------------------

choice
	prompt "Core count"
	default KICKOS_CORES_ONE

config KICKOS_CORES_ONE
	bool "One core"

config KICKOS_CORES_TWO
	bool "Two cores"

config KICKOS_CORES_FOUR
	bool "Four cores"

endchoice

config KICKOS_NUM_CORES
	int
	default 4 if KICKOS_CORES_FOUR
	default 2 if KICKOS_CORES_TWO
	default 1
	help
	  How many cores THIS IMAGE DRIVES, which is not the same as how many one kernel
	  schedules on: an AMP image drives every core it launches and runs a kernel per
	  core. Never prompted, the choice above stating it. At 1, arch_cpu_id() is a macro
	  expanding to a literal and no fallback TU exists, so a port that raises this and
	  ships no arch_cpu_id gets a link error rather than a kernel that believes it is on
	  core 0.

choice
	prompt "Multicore model"
	depends on !KICKOS_CORES_ONE
	default KICKOS_MULTICORE_SHARED

config KICKOS_MULTICORE_SHARED
	bool "One kernel across every core"
	help
	  An arch that declares no smp.cmake is refused at configure rather than at run
	  time: that declaration asserts coherent shared memory, an inter-core exclusion
	  primitive, an inter-core interrupt, a per-core identity, symmetric cores and
	  per-line interrupt targeting. A part meeting all six but the last runs this model
	  correctly and is declined it on the cost of the software that stands in.

config KICKOS_MULTICORE_AMP
	bool "One kernel per core, over disjoint memory"
	help
	  Each core runs its own kernel and its own memory, so no core needs another's
	  exclusion, and the predicate above does not apply. The cores reach each other
	  through the doorbell and a shared window, and every index and length read from
	  that window is another node's writing.

endchoice

config KICKOS_MULTICORE_MODEL_SHARED
	int
	default 1 if KICKOS_MULTICORE_SHARED
	default 0
	help
	  The model above as a number CMake reads, which is what the shared-kernel
	  predicate is refused against.

config KICKOS_KERNEL_CORES
	int
	default KICKOS_NUM_CORES if KICKOS_MULTICORE_SHARED
	default 1
	help
	  How many cores ONE KERNEL schedules on, which is every core the image drives
	  under the shared model and exactly one under AMP, where a node's peers run
	  kernels of their own. Per-core state inside struct Kernel is this many cells,
	  never KICKOS_NUM_CORES: an AMP node holding a cell for a core it does not
	  schedule describes a machine it is not.

# --- Memory protection ------------------------------------------------------

choice
	prompt "Memory model"
	default MEMORY_MODEL_FLAT

config MEMORY_MODEL_FLAT
	bool "Flat, no protection"

config MEMORY_MODEL_MPU
	bool "MPU / PMSA / PMP / RX-MPU region enforcement"
	depends on HAS_MPU
	help
	  Offered where a wild cross-domain access actually FAULTS, which needs the
	  chip's linker script to carve the .appdata window AND its arch to ship a
	  real arch_mpu_apply. A chip declares the capability by
	  selecting HAS_MPU in arch/Kconfig, which is also where to look for the
	  chips that can; bringing a new one up means the window, the backend, and
	  then that select once enforcement is validated on hardware.

endchoice

config KICKOS_HAVE_MPU
	int
	default 1 if MEMORY_MODEL_MPU
	default 0

# --- Paging mode ------------------------------------------------------------
# The level count is DERIVED from the selection
# (arch/riscv/rv64imac/include/kickos/arch/rv64_paging.h).
#
# satp.MODE is WARL, so a hart handed a mode it does not implement keeps the field it had;
# the prologue reads it back and refuses by name.

choice
	prompt "RV64 paging mode"
	depends on ARCH_RV64IMAC
	default RV64_PAGING_SV39

config RV64_PAGING_SV39
	bool "Sv39: three levels, 39-bit virtual addresses"

config RV64_PAGING_SV48
	bool "Sv48: four levels, 48-bit virtual addresses"
	help
	  One translation level more than Sv39, which costs one table page in the boot
	  image and one more non-leaf entry for the pre-translation prologue to fill: a
	  non-leaf entry holds the next table's frame number, and a shift of a
	  relocatable symbol is not a relocation any object format carries.

endchoice

config KICKOS_RV64_SATP_MODE
	int
	depends on ARCH_RV64IMAC
	default 8 if RV64_PAGING_SV39
	default 9 if RV64_PAGING_SV48
	help
	  satp.MODE at XLEN 64: the field the prologue writes, and the ONE value the
	  level count is derived from. Unprompted, the choice above being what a board
	  states.

# --- Interrupt controller ---------------------------------------------------
# The version is DERIVED from the selection: arch/CMakeLists.txt links one backend on it
# and cmake/kickos.cmake spells the emulated machine's gic-version from it.
#
# The two are different address maps: a GICv3 CPU interface is reached through ICC_* system
# registers instead of a memory-mapped frame, and the banked registers move to a per-core
# redistributor.

choice
	prompt "arm64 interrupt controller"
	depends on ARCH_ARMV8A
	# A default, not an enforcement: selecting the other value on that chip still configures,
	# and chip_imx8mp.cc is what refuses it.
	default ARM64_GIC_V3 if CHIP_IMX8MP
	default ARM64_GIC_V2

config ARM64_GIC_V2
	bool "GICv2: memory-mapped CPU interface"

config ARM64_GIC_V3
	bool "GICv3: system-register CPU interface, one redistributor per core"
	help
	  Obliges the chip to describe and reserve one redistributor frame per core,
	  which is a per-part fact an arch cannot supply, and adds a wake handshake per
	  core at bring-up. Software interrupts are generated in Group 1, so the timer
	  PPI must join them or the image boots, answers doorbells and never preempts.

endchoice

config KICKOS_ARM64_GIC_VERSION
	int
	depends on ARCH_ARMV8A
	default 2 if ARM64_GIC_V2
	default 3 if ARM64_GIC_V3

# The arch fact ARCH_TLS_FROM_SP, in the form CMake and C read.
config KICKOS_TLS_FROM_SP
	int
	default 1 if ARCH_TLS_FROM_SP
	default 0

# --- Userspace services and pin mux -----------------------------------------
# A board states its own default in boards/<board>/Kconfig.

config KICKOS_SERVICE_LIST
	string "CMake target defining kickos_board_services"
	default "kickos_services_none"

config KICKOS_BOARD_PINMAP
	string "CMake target defining kickos_board_pinmap"
	default "kickos_pinmap_none"

# --- Kernel provisioning ----------------------------------------------------

menu "Kernel provisioning"

config KICKOS_MULTI_INSTANCE
	bool "Several independent kernels in one address space"
	depends on ARCH_SIM
	default n
	help
	  Host one kernel per emulated MCU in a single process, which is how a fleet of
	  KickCAT slaves gets driven against an emulator and how the driver APIs get
	  exercised at scale. Gated to the sim: the selector is keyed on the host thread,
	  and a chip has neither host threads nor a second kernel to select.

	  Off, kickos_instance_index() folds to the literal 0, so the image carries one
	  literal for it and no load, multiply, branch or symbol, on the arch_cpu_id
	  model.

config KICKOS_MAX_INSTANCES
	int "Independent kernels the image provisions" if KICKOS_MULTI_INSTANCE
	range 1 256
	default 64 if KICKOS_MULTI_INSTANCE
	default 1
	help
	  Every instance-scoped object is this many copies, so raising it costs .bss
	  linearly across the whole tree, not just struct Kernel. It is a provisioning
	  bound like the pool sizes, not a preference.

config KICKOS_MAX_THREADS
	int "Static thread pool"
	range 2 64
	default 16

config KICKOS_MAX_SEMAPHORES
	int "CAP_SEM pool"
	range 0 64
	default 16

config KICKOS_MAX_MUTEXES
	int "CAP_MUTEX pool"
	range 0 64
	default 8

config KICKOS_MAX_ENDPOINTS
	int "IPC endpoint pool"
	range 0 32
	default 4

config KICKOS_MAX_FRAME_RUNS
	int "Frame-run capability objects"
	range 0 32
	default 8
	help
	  How many frame RUNS may be named by a capability at once. A run, not a
	  frame: the pool holds thousands of frames and a thread's capability table
	  holds single digits, so the unit a capability names is the run the frame
	  pool allocates. Only a translating board builds this pool.

config KICKOS_MAX_IRQ_HANDLES
	int "Tier-1 IRQ-as-event handles"
	range 0 32
	default 8

config KICKOS_MAX_SPAWN_GRANTS
	int "Caps one spawn may delegate"
	range 2 16
	default 6
	help
	  Costs caller stack, not .bss: thread_create_call stages the grant list in arrays
	  on the calling thread's own stack. The floor is 2, not 1: the child width is
	  this plus one plus the reply peak, and a width inside the reserved index
	  range leaves a child no slot of its own, which configure refuses.

config KICKOS_CAP_TABLE_SUPPLY
	int "Capability slots this board's RAM can back"
	range 7 64
	default 16
	help
	  SUPPLY, not demand. The width is summed from declared demand and refused
	  above this.

config KICKOS_USER_STACK_SIZE
	int "Default spawned-thread stack"
	range 512 262144
	default 65536
	help
	  What a spawn with no stack_base gets. Threads on it make syscalls, so it
	  must clear KICKOS_MIN_STACK_SIZE; the range floor here cannot say that,
	  the floor being per-arch, so thread.h asserts the relation instead and a
	  setting below it fails the build rather than the thread.

config KICKOS_IDLE_STACK_SIZE
	int "Idle thread stack"
	range 512 262144
	default 65536
	help
	  Idle is privileged and its body is arch_idle_wait alone, so it never enters
	  the syscall path and KICKOS_MIN_STACK_SIZE does not bind it. What does is
	  the PREEMPTION red zone, the frame a tick or a device IRQ builds on the
	  stack it interrupted plus whatever the kernel runs below that: 688 on lx6,
	  the deepest in the fleet, against 384 on rv32imac. The range floor cannot
	  state a per-arch figure, so each backend static_asserts its own zone against
	  this knob and a board set below it fails the build rather than the thread.

config KICKOS_ROOT_STACK_SIZE
	int "Root thread stack"
	range 512 262144
	default 65536
	help
	  Root runs userspace's ctors and main, so it makes syscalls and is bound by
	  KICKOS_MIN_STACK_SIZE the way a spawned thread is. kmain.cc asserts it.

config KICKOS_USER_HEAP_SIZE
	int "Userspace heap the linker script carves"
	range 0 1048576
	default 0 if CHIP_NRF51
	default 2048 if CHIP_STM32F302
	# 20 KiB of SRAM: at 8192 the heaviest stm32f103 image has no arena past the two
	# boot stacks.
	default 2048 if CHIP_STM32F103
	default 8192 if CHIP_STM32F411
	default 16384
	help
	  Read by the linker script. Every byte here is a byte the thread arena does
	  not get. Zero carves nothing and still prints: newlib falls back
	  to unbuffered stdio when the buffer malloc fails.

config KICKOS_KERNEL_STACKS
	int
	range 1 1 if ARCH_KERNEL_STACKS_MANDATORY
	default 1 if ARCH_KERNEL_STACKS_MANDATORY
	default 1 if ARCH_HAS_KERNEL_STACKS && HAS_MPU
	default 0
	help
	  Whether THIS board carves the per-thread kernel stacks, as a number the generated
	  header and the CMake fragment can carry, on the KICKOS_HAVE_MPU model. At 1 the
	  KICKOS_THREAD_SLOTS blocks of KICKOS_KERNEL_STACK_SIZE are one array in kernel
	  .bss, kmain arms each slot's canary and fill at init, and thread_create seats each
	  pool thread's ctx.kernel_sp on its slot's block. At 0 the array is not compiled,
	  every kernel_sp stays 0, and the arch entry keeps its red zone instead.

	  IT IS KEYED ON THE CHIP CAPABILITY, NOT THE BOARD'S POSTURE. HAS_MPU says the
	  silicon can enforce; MEMORY_MODEL_MPU, and so KICKOS_HAVE_MPU, says this variant
	  switched it on. The question here is whether the board can AFFORD the blocks,
	  which is a RAM question, and RAM does not change between a board's enforcing and
	  flat variants. Keying on the capability also stops one board's variants compiling
	  different entry paths, which would put the arch's syscall geometry inside a
	  per-variant #if.

	  ARCH_HAS_KERNEL_STACKS alone is not enough: on a chip with no MPU the transfer
	  buys robustness and not isolation, there being no privilege boundary for a
	  trusted stack to protect, so the red zone serves instead at a fraction of the RAM.

	  ON THREE ARCHES 0 IS NOT A LEGAL RESOLUTION AT ALL. armv6m, rv32imac and rxv3
	  select ARCH_KERNEL_STACKS_MANDATORY: their switch.S compiles the transfer with no
	  red-zone path beside it, and their backends static_assert this knob non-zero. The
	  `default 1 if ARCH_KERNEL_STACKS_MANDATORY` is placed FIRST for that reason, so no
	  chip capability or board opt-in can steer the resolution below what the code it
	  configures accepts. armv7m does NOT select it, being the one arch that legitimately
	  resolves 0 (stm32f302 and sam3x8e).

	  The `range 1 1` states that invariant rather than enforcing it: this symbol has no
	  prompt, so tools/kconfig/genconfig.py refuses any requested value by name before it
	  looks at ranges. The range binds only if the knob ever gains a prompt.

	  NOT AN ARENA CARVE, so cmake/boot_arena.cmake names nothing here. The block grows
	  kernel .bss, which raises __kickos_ram_start and shrinks the arena above it, and
	  the two arena asserts in arch/common/boot_arena.ld.h refuse the link when what is
	  left cannot back the boot stacks or the thread pool.

config KICKOS_KERNEL_STACK_SIZE
	int
	default 1184 if ARCH_RV32IMAC
	# PROVISIONAL: taken from armv8a, not measured on this arch.
	default 4096 if ARCH_RV64IMAC
	# PROVISIONAL: not measured, and above every 32-bit figure because the uniform
	# exception frame is 800 bytes and a blocking syscall holds two of them at once.
	default 4096 if ARCH_ARMV8A
	# PROVISIONAL: taken from armv8a, not measured on this arch. The backend asserts a
	# structural floor of 368.
	default 4096 if ARCH_X86_64
	default 1104 if ARCH_RXV3
	default 1472 if ARCH_ARMV7M && TELEMETRY_RTT
	default 1008 if ARCH_ARMV7M
	default 896 if ARCH_ARMV6M
	default 1024
	help
	  The stack a thread's PRIVILEGED dispatch runs on, the trap entry transferring to
	  it instead of continuing on the thread's own. One size class per board, so it is
	  a constant here and not a per-thread field.

	  NOT A KNOB, which is why it has no prompt. Every default below is what the arch's
	  deepest transferred dispatch measures, a board may only RAISE it, and a raise buys
	  nothing the gate asks for while costing KICKOS_THREAD_SLOTS bytes per byte.

	  EVERY DEFAULT ABOVE IS A MEASUREMENT, on all four arches that carve a block:
	  rv32imac, rxv3, armv7m and armv6m. trap_redzone_roots.txt declares the
	  transferred class stack=kernel and check_trap_redzone.sh measures it against this
	  knob rather than against the spawn floor. Each arch derives its own terms in its
	  own <arch>_trap_stack.h, which is where to read what a figure is made of; no
	  derivation is copied here, because a copy of a measurement goes stale.

	  TELEMETRY IS ITS OWN SIZE CLASS ON armv7m, and it must not be folded into one
	  number. KICKOS_TELEMETRY compiles the trace emitters and the ring drain
	  arch_shutdown runs, which the dispatch reaches through exit_current as well as
	  through the panic tail; it is the largest posture effect in the fleet. The blocks
	  are per thread SLOT, so one byte here costs KICKOS_THREAD_SLOTS bytes of kernel
	  .bss, and applying the telemetry figure fleet-wide fails to link the boards that
	  have no telemetry variant.

	  A BOARD MAY ONLY RAISE IT. Each arch backend static_asserts the ARCH depth macro,
	  so a defconfig figure below the arch default fails the build even on a board whose
	  own reading is lower. Tightening a board below its arch is a change to the assert
	  and to what the depth macro means, not a defconfig line.

	  WHICH BOARDS PAY. Only where KICKOS_KERNEL_STACKS is 1: the block is
	  KICKOS_THREAD_SLOTS of this size in kernel .bss, and the banner reports slot size,
	  slot count and their product. An arch that carves the blocks stops reserving a red
	  zone for the dispatch, so no board ever holds both.

config KICKOS_TLS
	bool "Per-thread thread_local storage"
	depends on ARCH_HAS_TLS
	default y
	help
	  Give each thread its own copy of every thread_local, carved off the LOW end of
	  that thread's own stack block. The SIZE is not a knob: it is .tdata plus .tbss as
	  the linker lays the template out, plus whatever the ABI reserves below the thread
	  pointer. A number typed into a defconfig cannot track a template the linker owns.
	  With no thread_local declared the carve is zero bytes and this costs nothing.

	  IT DOES NOT GIVE YOU A PER-THREAD errno. newlib reaches its reentrant state
	  through _impure_ptr, not through a thread_local, so errno and the rest of that
	  state come from the per-thread struct _reent every non-sim board carries, not
	  from this knob.

	  IT COSTS NO MPU DESCRIPTOR. The stack is already one region under one descriptor,
	  and the carve is inside it. Raising ctx.stack_lo above the carve is what keeps a
	  thread's own SP out of its own TLS.

	  WHAT IT IS NOT: an isolation boundary. Peers in a task share the whole .appdata
	  window, so a thread_local is a NAMING mechanism, private by convention and not by
	  hardware.

	  THE MECHANISM IS NOT ONE REGISTER ON EVERY ISA. RISC-V and Xtensa have a thread
	  pointer (tp, THREADPTR) the kernel writes at restore. Every ARM part in this fleet
	  is M-profile and has none, so the compiler emits a call to __aeabi_read_tp, which
	  libc and libgcc both leave undefined and the kernel must answer. RX has neither
	  and falls back to emutls. ARCH_HAS_TLS in arch/Kconfig says which arch answers
	  how, and which one cannot.

	  ON RISC-V `tp` IS USER-WRITABLE. An unprivileged thread can put anything in it, so
	  privileged code that read thread-local state through the incoming tp would trust a
	  value the thread chose. The entry never reads it: tp is written FROM the control
	  block at both ends, exactly as gp already is.

	  IT FORCES POWER-OF-TWO STACK SIZES. Unprivileged code on ARM has no register that
	  differs per thread except SP, so __aeabi_read_tp is SP masked down to the thread's
	  own block. That is correct only when the blocks are STRIDED by a power of two, so
	  with this on every arena block is aligned to its own rounded size and
	  KICKOS_USER_STACK_SIZE and KICKOS_ROOT_STACK_SIZE must be powers of two and must
	  round to the SAME one. The top-level CMakeLists.txt refuses each failure by name at
	  configure time, and cmake/boot_arena.cmake mirrors the align leg so the link-time
	  assert models the geometry the allocator produces. On a part too small to pay that
	  rounding, turning this off costs a thread_local and keeps a thread: f302nucleo and
	  bluepill-c8 both make that trade.

config KICKOS_MIN_STACK_SIZE
	int
	default 896 if ARCH_ARMV6M
	# A model ceiling and not an observed overrun: at this depth the chain runs inside
	# the IrqLock exit_current holds, so the frame term cannot be spent.
	# armv7m_trap_stack.h.
	default 1088 if ARCH_ARMV7M && TELEMETRY_RTT
	default 960 if ARCH_ARMV7M
	default 1024 if ARCH_RXV3
	# PROVISIONAL: not measured on this arch. Raised off the generic 1024 for an
	# 800-byte uniform exception frame against armv7m's ~100.
	default 2048 if ARCH_ARMV8A
	# Under KICKOS_BENCH alone, or every non-bench rv32imac board reserves for a
	# console bracket it does not compile. rv_trap_stack.h.
	default 1088 if ARCH_RV32IMAC && KICKOS_BENCH
	default 1024 if ARCH_RV32IMAC
	# PROVISIONAL: taken from armv8a, not measured on this arch.
	default 2048 if ARCH_RV64IMAC
	default 896 if ARCH_LX6
	default 1024
	help
	  The floor for a caller-provided stack: the arch's deepest thread-exit dispatch,
	  measured. A stack below it passes the spawn check and then overflows on exit.

	  WHAT IT STILL COVERS, now that a thread has a kernel block.
	  kickos_fault_stack_top answers with ctx.kernel_sp, so kickos_thread_fault_exit and
	  kickos_thread_slay_exit run on the dying thread's KERNEL block and are measured
	  against that block, as EXITK, not against this floor. What this floor holds is
	  kickos_thread_return, measured as RET: an entry return, with no fault and no
	  redirect, so no entry design relocates it. armv7m carries a third class, EXIT, for
	  the presets that carve no block and where all three stubs therefore stay here.

	  THE FRAME TERM IS NOT ZERO ON ANY ARCH. Each stub is entered by an exception
	  return, in thread mode, with interrupts enabled, and its exit_current reschedules,
	  so a preemption below the descent is the ordinary case. Each arch prices that
	  window in its own <arch>_trap_stack.h, which is where to read the terms; no figure
	  is repeated here, because a copy of a measurement goes stale.

	  IT MUST ALSO DOMINATE ANY RED ZONE. On a backend whose trap prologue enforces one
	  below the interrupted sp, a thread whose whole stack is smaller cannot satisfy the
	  prologue at all: it does not overflow on a syscall, it is refused every time.
	  Three backends enforce a red zone and none of them over a C dispatch: the two ARM
	  backends over the window svc_trampoline spends on the thread's PSP before it
	  reaches ctx.kernel_sp, and rxv3 over that same window plus the context SAVE its
	  two trap arms leave on the caller's own USP, which they leave there because the
	  ISA's return path computes the resume SP from where that save sits.

	  RV32IMAC ENFORCES NONE, its entry having moved every U-mode frame onto the
	  thread's kernel stack, so there this floor covers the two descents that still
	  spend a thread's own stack. A PRIVILEGED thread's SYSCALL is one: its ecall
	  arrives with mstatus.MPP=M and keeps frame and dispatch on the sp it interrupted,
	  and no bound exists to refuse a floor-sized privileged thread's syscall. The death
	  path is the other, and it spends the stack of every thread whatever its privilege.

	  THE ARM BACKENDS AND RXV3 HAVE NO SUCH SPLIT. SVC_Handler clears CONTROL.nPRIV for
	  every caller and svc_trampoline transfers on a PSP write rather than on a cause
	  branch, so a privileged thread's syscall runs on its kernel block exactly as an
	  unprivileged one's does. RX is the same shape for the same reason: INT #SYS is one
	  vector whichever mode issued it, its rewrite clears PSW.PM unconditionally, and
	  the transfer is a write to R0.

	  TWO THINGS CHECK THE RELATION, AND THEY ARE NOT THE SAME CHECK.
	  check_trap_redzone.sh compares this floor against every class that spends a thread
	  stack, per board, on the presets it is registered for. Each arch backend ALSO
	  static_asserts it, on every build of every board, and on the two ARM backends that
	  assertion is the stricter one: it adds the exception frame entry stacks ABOVE the
	  pointer the guard validates, which the gate does not model and which a floor-sized
	  thread pays before the guard ever runs. Keeping both buys coverage, not
	  strictness: the gate runs on registered presets, the assert on every image.

endmenu

# --- Console and telemetry --------------------------------------------------

menu "Console and telemetry"

choice
	prompt "Kernel console backend"
	default CONSOLE_CHIP

config CONSOLE_NONE
	bool "none"

config CONSOLE_CHIP
	bool "chip native transport"

config CONSOLE_RTT
	bool "SEGGER RTT"

config CONSOLE_BOTH
	bool "chip + RTT"

endchoice

# The RTT console transport is a plain RAM ring and reads no clock (lib/rtt.cc), so it
# does not depend on HAS_TRACE_CLOCK; telemetry, which needs arch_trace_now, does.

config KICKOS_CONSOLE
	string
	default "none" if CONSOLE_NONE
	default "chip" if CONSOLE_CHIP
	default "rtt" if CONSOLE_RTT
	default "both" if CONSOLE_BOTH

choice
	prompt "Telemetry transport"
	default TELEMETRY_OFF

config TELEMETRY_OFF
	bool "off"

config TELEMETRY_RTT
	bool "RTT channel 1"
	depends on HAS_TRACE_CLOCK && (CONSOLE_RTT || CONSOLE_BOTH)

endchoice

config KICKOS_TELEMETRY
	string
	default "rtt" if TELEMETRY_RTT
	default "off"

config KICKOS_RTT_CH1_SIZE
	int "RTT channel-1 ring bytes"
	depends on CONSOLE_RTT || CONSOLE_BOTH
	range 256 65536
	default 4096
	help
	  A whole run has to fit, so a long trace raises it. The default matches the
	  rtt.cc fallback. It sizes up1_buf, which the RTT CONSOLE links.

endmenu

# --- Debug and test ---------------------------------------------------------

menu "Debug and test"

config KICKOS_DEBUG
	bool "Internal-consistency guards"
	default n

config KICKOS_ENABLE_SELFTEST
	bool "Test-only self-test syscalls"
	default n

config KICKOS_SHUTDOWN_TO_BOOTLOADER
	bool "Terminating images reboot into the chip bootloader"
	depends on KICKOS_ENABLE_SELFTEST
	default n
	help
	  arch_reboot is compiled out of a production image, so without the self-test
	  syscalls nothing defines the symbol.

config KICKOS_BENCH
	bool "Cycle-accurate context-switch microbench"
	default n
	help
	  Brackets the switch body with the core's own cycle counter. That counter is
	  not arch_trace_now, so this knob does not answer to HAS_TRACE_CLOCK; the
	  brackets live in each switch.S that carries them.

config SCHED_PERIODIC_TICK
	bool "Force a classic periodic scheduler tick"
	default n

config KICKOS_PANIC_DUMP
	int "CPU-context dump on a fault (0/1)"
	default 1
	range 0 1
	help
	  Off keeps the fault banner and drops the register dump under it. Five
	  tests read a named register out of that dump and fail by name when it is
	  missing, so a board turning this off de-registers nothing and reports.

config KICKOS_DIAG_TERSE
	int "Diagnostic messages as short codes (0/1)"
	default 0
	range 0 1
	help
	  Trades the kernel's prose for the short column of include/kickos/diag.h
	  and reduces an assert to its file and line. Fault banners are unchanged in
	  either posture, so panic detection is unaffected; the prose a test script
	  matches BELOW a banner is not, which is why this is a board's choice and the
	  default is the full text.

endmenu
```
